## config/west.yml
```yaml
manifest:
  remotes:
    - name: zmkfirmware
      url-base: https://github.com/zmkfirmware
  - name: caksoylar  # for rgbled battery and connectivity status
      url-base: https://github.com/caksoylar
  projects:
    - name: zmk
      remote: zmkfirmware
      revision: main
      import: app/west.yml
    - name: zmk-rgbled-widget  # for rgbled battery and connectivity status
      remote: caksoylar
      revision: main
  self:
    path: config
```
